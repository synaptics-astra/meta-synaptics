## conf/layer.conf
```bitbake
# We have a conf and classes directory, append to BBPATH
BBPATH .= ":${LAYERDIR}"

# We have recipes directories containing .bb and .bbappend files, add to BBFILES
BBFILES += "${LAYERDIR}/recipes*/*/*.bb ${LAYERDIR}/recipes*/*/*.bbappend"

BBFILE_COLLECTIONS += "meta-synaptics"
BBFILE_PATTERN_meta-synaptics := "^${LAYERDIR}/"
BBFILE_PRIORITY_meta-synaptics = "29"

LAYERDEPENDS_meta-synaptics = "core"

LAYERSERIES_COMPAT_meta-synaptics = "kirkstone"

BBFILES_DYNAMIC += " \
    rdk:${LAYERDIR}/dynamic-layers/rdk/recipes-*/*/*.bb \
    rdk:${LAYERDIR}/dynamic-layers/rdk/recipes-*/*/*.bbappend \
    \
    video:${LAYERDIR}/dynamic-layers/rdk-video/recipes-*/*/*.bb \
    video:${LAYERDIR}/dynamic-layers/rdk-video/recipes-*/*/*.bbappend \
    \
    openembedded-layer:${LAYERDIR}/dynamic-layers/openembedded-layer/*/*/*.bb \
    openembedded-layer:${LAYERDIR}/dynamic-layers/openembedded-layer/*/*/*.bbappend \
    \
    multimedia-layer:${LAYERDIR}/dynamic-layers/multimedia-layer/*/*/*.bb \
    multimedia-layer:${LAYERDIR}/dynamic-layers/multimedia-layer/*/*/*.bbappend \
    \
    qt5-layer:${LAYERDIR}/dynamic-layers/qt5-layer/*/*/*.bb \
    qt5-layer:${LAYERDIR}/dynamic-layers/qt5-layer/*/*/*.bbappend \
"

ASTRA_VERSION = "0.9.0"
SYNAP_VERSION = "3.0"

include syna-sources-git.conf
```

## conf/machine/include/syna-sdk.inc
```bitbake
#/*******************************************************************************
#*
#*             Copyright 2020, Beechwoods Software, Inc.
#*
#*******************************************************************************/

SYNA_SDK_NAME = "syna"
SYNA_SDK_BUILD = "-release"
DISTRO_CONFIG= "${@d.getVar('DISTRO').replace('-', '_')}"
```

## conf/machine/include/syna.inc
```bitbake
#/*******************************************************************************
#*
#*             Copyright 2020, Beechwoods Software, Inc.
#*
#*******************************************************************************/

SOC_FAMILY = "syna"
include conf/machine/include/soc-family.inc

SERIAL_CONSOLE = "115200 ttyS0"

IMAGE_CLASSES += "image_synaimg"
IMAGE_FSTYPES ?= "synaimg"

KERNEL_IMAGETYPE ?= "Image"

MACHINE_FEATURES += "apm usbhost keyboard vfat alsa"

MACHINE_EXTRA_RRECOMMENDS += " \
    kernel-modules \
    kernel-firmware-sdsd8997-combo-v4 \
    linux-firmware-syna \
"

# Synaptics BSP default providers
PREFERRED_PROVIDER_virtual/bootloader ?= "syna-bootloader"
PREFERRED_PROVIDER_virtual/kernel ?= "linux-syna"
PREFERRED_PROVIDER_virtual/egl ?= "mesa"
PREFERRED_PROVIDER_virtual/libgles1 ?= "mesa"
PREFERRED_PROVIDER_virtual/libgles2 ?= "mesa"
PREFERRED_PROVIDER_virtual/mesa ?= "mesa"
PREFERRED_PROVIDER_virtual/libpvr-dri-support ?= "synasdk-gpu-pvr"
PREFERRED_PROVIDER_virtual/libgles1-pvr ?= "synasdk-gpu-pvr"
PREFERRED_PROVIDER_virtual/libgles2-pvr ?= "synasdk-gpu-pvr"
PREFERRED_PROVIDER_virtual/libpvr-scope-srv ?= "synasdk-gpu-pvr"
PREFERRED_PROVIDER_virtual/pvr-fw ?= "synasdk-gpu-pvr"
MACHINE_EXTRA_RRECOMMENDS += "synasdk-gpu-pvr"
```

## conf/machine/sl1620.conf
```bitbake
#@TYPE: Machine
#@NAME: sl1620
#@DESCRIPTION: Machine configuration for the MYNA2 SoC
require conf/machine/include/arm/armv8-2a/tune-cortexa55.inc

include conf/machine/include/syna.inc
include conf/machine/include/syna-sdk.inc

MACHINEOVERRIDES =. "myna2:"

SYNA_SDK_CONFIG_NAME ?= "sl1620_${DISTRO_CONFIG}_rdk"
SYNA_SDK_CONFIG_FILE ?= "${SYNA_SDK_CONFIG_NAME}_defconfig"
SYNA_SDK_CONFIG_NAME_ALT ?= "sl1620_${DISTRO_CONFIG}_aarch64_rdk"
SYNA_SDK_CONFIG_FILE_ALT ?= "${SYNA_SDK_CONFIG_NAME_ALT}_defconfig"
SYNA_KERNEL_CONFIG_FILE ?= "myna2_defconfig"
SYNA_KERNEL_DTS_FILE ?= "synaptics/myna2-rdk.dtb"

# WPE buffer size for media (important for youtube in 4K)
# 30MB for 1GB DRAM systems, 90MB for 2GB DRAM systems
SYNA_MEDIASOURCE_VIDEO_BUFFER_SIZE = "30"
# WPE RAM size limits, 192/200 for 1GB DRAM systems, 320/340 for 2GB DRAM systems
# (important to prevent memory pressure)
SYNA_WPE_RAM_SIZE = "190"
SYNA_WPE_WEB_PROCESS_RAM_SIZE = "200"

PREFERRED_VERSION_linux-syna:sl1620 = "5.15.140"
PREFERRED_VERSION_linux-firmware-syna:sl1620 = "5.15.140"

PREFERRED_PROVIDER_virtual/bootloader:sl1620 = "syna-u-boot"
```

## conf/machine/sl1640.conf
```bitbake
#@TYPE: Machine
#@NAME: sl1640
#@DESCRIPTION: Machine configuration for the PLATYPUS SoC
require conf/machine/include/arm/armv8-2a/tune-cortexa55.inc

include conf/machine/include/syna.inc
include conf/machine/include/syna-sdk.inc

MACHINEOVERRIDES =. "platypus:"

SYNA_SDK_CONFIG_NAME ?= "sl1640_${DISTRO_CONFIG}_rdk"
SYNA_SDK_CONFIG_FILE ?= "${SYNA_SDK_CONFIG_NAME}_defconfig"
SYNA_SDK_CONFIG_NAME_ALT ?= "sl1640_${DISTRO_CONFIG}_aarch64_rdk"
SYNA_SDK_CONFIG_FILE_ALT ?= "${SYNA_SDK_CONFIG_NAME_ALT}_defconfig"
SYNA_KERNEL_CONFIG_FILE ?= "platypus_defconfig"
SYNA_KERNEL_DTS_FILE ?= "synaptics/platypus-rdk.dtb"

# WPE buffer size for media (important for youtube in 4K)
# 30MB for 1GB DRAM systems, 90MB for 2GB DRAM systems
SYNA_MEDIASOURCE_VIDEO_BUFFER_SIZE = "90"
# WPE RAM size limits, 192/200 for 1GB DRAM systems, 320/340 for 2GB DRAM systems
# (important to prevent memory pressure)
SYNA_WPE_RAM_SIZE = "320"
SYNA_WPE_WEB_PROCESS_RAM_SIZE = "340"

PREFERRED_VERSION_linux-syna:sl1640 = "5.15.140"
PREFERRED_VERSION_linux-firmware-syna:sl1640 = "5.15.140"

PREFERRED_PROVIDER_virtual/bootloader:sl1640 = "syna-u-boot"
```
